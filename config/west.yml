## config/west.yml
```yaml
manifest:
  remotes:
    - name: zmkfirmware
      url-base: https://github.com/zmkfirmware
      # Additional modules containing boards/shields/custom code can be listed here as well.
      # See:
      # - https://zmk.dev/docs/features/modules
      # - https://docs.zephyrproject.org/3.5.0/develop/west/manifest.html#projects
    - name: urob
      url-base: https://github.com/urob
    - name: m165437 #gem shield
      url-base: https://github.com/M165437
  projects:
    - name: nice-view-gem
      remote: m165437
      revision: v0.3.0
    - name: eyelash_corne
      url: https://github.com/a741725193/zmk-new_corne
      revision: v0.3.0
    - name: zmk
      remote: zmkfirmware
      revision: v0.3.0
      import: app/west.yml
  self:
    path: boards
```
